## zephyr/boards/atmel/NxG_Court/board.yml
```yaml
board:
  name: nxg_court
  full_name: NxG Court
  vendor: atmel
  socs:
    - name: samd21g18a
```

## zephyr/boards/atmel/NxG_Long/board.yml
```yaml
board:
  name: nxg_long
  full_name: NxG Long
  vendor: atmel
  socs:
    - name: samd21j18a
```

## zephyr/boards/atmel/NxG_Long/nxg_long_defconfig
```kconfig
CONFIG_SOC_ATMEL_SAMD_DEFAULT_AS_MAIN=y
CONFIG_SOC_ATMEL_SAMD_NVM_WAIT_STATES=0

CONFIG_BUILD_OUTPUT_HEX=y

CONFIG_CONSOLE=y
CONFIG_SERIAL=y
CONFIG_UART_CONSOLE=y
CONFIG_UART_INTERRUPT_DRIVEN=y
```
