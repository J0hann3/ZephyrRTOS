## CMakeLists.txt
```
cmake_minimum_required(VERSION 3.20.0)

list(APPEND BOARD_ROOT C:\\Users\\JohanneVIGNY\\ZephyrRTOS)  # Define path to board

find_package(Zephyr)    # pull zephyr and create a tagret named 'app'
project(my-app)     # Must be call after the previous line to avoid conflict
                    # Define my CMake application project

target_sources(app PRIVATE src/main.c
                            src/lum_sensor.c
                            src/temp_hum_sensor.c
                            src/sd_card.c
                            src/measures_logger.c)  # Add my-app to the app(zephyr) project

target_include_directories(app PRIVATE include src)
```

## prj.conf
```kconfig
CONFIG_I2C=y
CONFIG_LOG=y
CONFIG_LOG_MODE_IMMEDIATE=y
CONFIG_GPIO=y
```

## src/main.c
```c
// #include <zephyr/drivers/i2c.h>
// #include <zephyr/drivers/gpio.h>
#include "lum_sensor.h"
#include "temp_hum_sensor.h"
#include "sd_card.h"

static FATFS fat_fs;

static struct fs_mount_t mp = {
    .type = FS_FATFS,
    .fs_data = &fat_fs,
    .mnt_point = "/SD:",
};

int main()
{
    // const struct i2c_dt_spec lum_device = I2C_DT_SPEC_GET(I2C_LUM_NODE);
    const struct i2c_dt_spec temp_device = I2C_DT_SPEC_GET(I2C_TEMP_NODE);
    // const struct gpio_dt_spec vcc_sensor = GPIO_DT_SPEC_GET(DT_NODELABEL(vcc_sensor), gpios);
    
    // uint16_t light;
    uint16_t temp;
    uint16_t humidity;

    if (!device_is_ready(temp_device.bus)) 
        return 1;
    // if (!device_is_ready(lum_device.bus)) 
    //     return 1;
    // if (!gpio_is_ready_dt(&vcc_sensor))
    //     return 1;
    test(&fat_fs, &mp);
    while (1)
    {
        k_sleep(K_MSEC(1000));
        // if (init_and_read_lum_sensor(&lum_device, &vcc_sensor, &light) == 1)
            // return 1;
        if (read_temp_sensor(&temp_device, &temp, &humidity) == 1)
            return 1;
    }
    return 0;
}
```

## src/lum_sensor.c
```c
#include "lum_sensor.h"

int init_lum_sensor(const struct i2c_dt_spec *lum_device, const struct gpio_dt_spec *vcc_sensor)
{
    // Init Vcc sensor to then configure i2c device(light sensor)
    if (gpio_pin_configure_dt(vcc_sensor, GPIO_OUTPUT_ACTIVE) < 0) 
        return 1;

    k_msleep(5);
    
    uint8_t config[3] = {0x00, 0x00, 0x00}; // { commmand config, config LSB, config MSB }, config => gain 1, IT => 100ms, Pers => 1

    if (i2c_write_dt(lum_device, config, 3) != 0)
        return 1;
    return 0;
}

uint8_t read_lum_sensor(const struct i2c_dt_spec *lum_device, uint16_t *light)
{
    uint8_t sensor_reg = 0x04;
    uint8_t lum_reading[2]= {0};

    int ret = i2c_write_read_dt(lum_device, &sensor_reg, 1, &lum_reading[0], 2);
    if(ret != 0){
        printf("Failed to write/read I2C device address %x at Reg. %x \n\r", lum_device->addr, sensor_reg);
        return 1;
    }
    *light = ((uint16_t)lum_reading[1] << 8) + lum_reading[0];
    printf("Light sensor: %d\n", *light);
    return 0;
}

uint8_t init_and_read_lum_sensor(const struct i2c_dt_spec *lum_device, const struct gpio_dt_spec *vcc_sensor, uint16_t *light)
{
	if (init_lum_sensor(lum_device, vcc_sensor) == 1){
		printf("Init i2c error\n");
		return 1;
	}
    k_msleep(150);
	if (read_lum_sensor(lum_device, light))
		return 1;
	
    gpio_pin_configure_dt(vcc_sensor, GPIO_INPUT | GPIO_PULL_UP);
	return 0;
}

int routine_read_lum(const struct i2c_dt_spec *lum_device)
{
    uint16_t light;
    while (1)
    {
        k_msleep(1000);
        if (read_lum_sensor(lum_device, &light) == 1)
            return 1;
    }
    return 0;
}
```

## src/lum_sensor.h
```c
#ifndef LUM_SENSOR_H
# define LUM_SENSOR_H

#include <zephyr/drivers/i2c.h>
#include <zephyr/drivers/gpio.h>

#define I2C_LUM_NODE DT_NODELABEL(lum_sensor)
#define VCC_SENSOR_NODE DT_NODELABEL(vcc_sensor)

#if !DT_NODE_HAS_STATUS_OKAY(VCC_SENSOR_NODE)
#error "Unsupported board: vcc sensor devicetree nodelabel is not defined"
#endif

#if !DT_NODE_HAS_STATUS_OKAY(I2C_LUM_NODE)
#error "Unsupported board: sensor devicetree nodelabel is not defined"
#endif

int init_lum_sensor(const struct i2c_dt_spec *lum_device, const struct gpio_dt_spec *vcc_sensor);
uint8_t read_lum_sensor(const struct i2c_dt_spec *lum_device, uint16_t *light);
uint8_t init_and_read_lum_sensor(const struct i2c_dt_spec *lum_device,
            const struct gpio_dt_spec *vcc_sensor, uint16_t *light);
int routine_read_lum(const struct i2c_dt_spec *lum_device);

#endif
```

## src/measures_logger.h
```c
#ifndef MEASURES_LOGGER_H_
#define MEASURES_LOGGER_H_

#include <stdbool.h>
#include <stddef.h>
#include <stdint.h>

/**
 * To reduce power consumption, the stack should be big enough to store all the measurements done in a day.
 * So only one copy to the SD card should be done every days.
 * As the worst case is a measurement every 5 minutes, that means (24*60min)/5min = 288 measurement.
 *
 * But the micro memory is not big enough to store that many measurements.
 * So it was decided to reduce the stack size by a factor of 2. And make a copy to SD card twice a day.
 */
#define MEASURES_LOGGER_MAX_SIZE 12

typedef enum
{
  /* Operation succeeded */
  MEASURES_LOGGER_RES_SUCCESS = 1,
  /* Operation failed */
  MEASURES_LOGGER_RES_FAILURE = 0

} MEASURES_LOGGER_RESULT;

typedef enum
{
  MEASURES_LOGGER_ERROR_OK = 0,
  MEASURES_LOGGER_INVALID_MEASURING_PERIOD,
  MEASURES_LOGGER_INVALID_PARAMETER,
  MEASURES_LOGGER_NOTHING_TO_READ,
  MEASURES_LOGGER_UNREADED_MEASURES,
  MEASURES_LOGGER_UNINITIALIZED
} MEASURES_LOGGER_ERROR;

typedef struct
{
  // struct calendar_date_time datetime;
  uint16_t                  temperature;
  uint16_t                  humidity;
  uint16_t                  brightness;

  // Sensors activation
  uint8_t TEMP_HUM_SENSOR_EN : 1;
  uint8_t LUM_SENSOR_EN      : 1;
} measure_t;

typedef struct
{
	uint16_t              head;  // write index
	uint16_t              tail;  // read index
	uint16_t              size;
	uint16_t              counter;
	MEASURES_LOGGER_ERROR errorValue;
	measure_t             measure[MEASURES_LOGGER_MAX_SIZE];
} measures_stack_t;

/**
 *  @brief Initialize stack size.
 *    Stack is sized to get two copy by day.
 *
 *  @param Period between 2 measurements in minutes
 *
 *  @retval   MEASURES_LOGGER_RES_SUCCESS
 *  @retval   MEASURES_LOGGER_RES_FAILURE
 */
bool measures_logger_init(const uint16_t measuring_period);

/**
 *  @brief Calculate difference between write and read index.
 *
 *  @param No parameters
 *
 *  @returns
 *      result of difference between write and read index.
 */
size_t measures_logger_count();

/**
 *  @brief
 *    Return stack size according to measuring_period given to
 *    measures_logger_init().
 *
 *    size = minutes in a day (1440) / measuring_period in minutes.
 *
 *  @param No parameters
 *
 *  @returns result stack size.
 */
uint16_t measures_logger_get_size();

/**
 *  @brief logger error.
 *
 *  @param No parameters
 *
 *  @returns
 *      last error.
 */
MEASURES_LOGGER_ERROR measures_logger_get_error();

/**
 *  @brief Write new_measure to m_stack at head index.
 *
 *  @param measure_t new_measure
 *
 *
 * @retval    MEASURES_LOGGER_RES_FAILURE if one of the parameters is NULL.
 * @retval    MEASURES_LOGGER_RES_FAILURE if overloop on unread data.
 * @retval    MEASURES_LOGGER_RES_SUCCESS.
 */
bool measures_logger_write(const measure_t* new_measure);

/**
 *  @brief Read last measure from m_stack at tail index.
 *
 *  @param measure_t last_measure will be updated
 *
 *  @retval   MEASURES_LOGGER_RES_SUCCESS
 *  @retval   MEASURES_LOGGER_RES_FAILURE
 */
bool measures_logger_read(measure_t* last_measure);

/**
 *  @brief Read last measure and return value as CSV line.
 *
 *  @param[in,out] char* csvLine
 *
 *  @retval   MEASURES_LOGGER_RES_SUCCESS
 *  @retval   MEASURES_LOGGER_RES_FAILURE
 */
bool measures_logger_read_CSV(char s_return[160]);

#endif /* MEASURES_LOGGER_H_ */
```

## src/sd_card.c
```c
#include "sd_card.h"

int lsdir(const char *path)
{
	struct fs_dir_t dirp;
	static struct fs_dirent entry;

	fs_dir_t_init(&dirp);

	if (fs_opendir(&dirp, path)) {
		printf("Error opening dir %s\n", path);
		return 1;
	}

	printf("\nListing dir %s ...\n", path);
	for (;;) {
		if (fs_readdir(&dirp, &entry) || entry.name[0] == 0)
			break;

		if (entry.type == FS_DIR_ENTRY_DIR) {
			printf("[DIR ] %s\n", entry.name);
		} else {
			printf("[FILE] %s (size = %zu)\n",
				entry.name, entry.size);
		}
	}
	fs_closedir(&dirp);
	return 0;
}

int test(FATFS *fat_fs, struct fs_mount_t *mp)
{
    const struct gpio_dt_spec vcc_sd = GPIO_DT_SPEC_GET(DT_NODELABEL(vcc_sd), gpios);
    const char *disk_pdrv = "SD";
    uint64_t memory_size_mb;
    uint32_t block_count;
    uint32_t block_size;

    // Init Vcc sd card to then configure spi device(sd card)
    if (gpio_pin_configure_dt(&vcc_sd, GPIO_OUTPUT_ACTIVE) < 0) 
        return 1;
    k_msleep(50);
    if (disk_access_ioctl(disk_pdrv, DISK_IOCTL_CTRL_INIT, NULL) != 0) {
        printf("Error init device\n");
        return 1;
    }
    if (disk_access_ioctl(disk_pdrv,DISK_IOCTL_GET_SECTOR_COUNT, &block_count) != 0) {
        printf("Error get sector count\n");
        return 1;
    }
    printf("Block count %u\n", block_count);
    if (disk_access_ioctl(disk_pdrv, DISK_IOCTL_GET_SECTOR_SIZE, &block_size)) {
        printf("Unable to get sector size\n");
        return 1;
    }
    printf("Sector size %u bytes\n", block_size);

    memory_size_mb = (uint64_t)block_count * block_size;
	printf("Memory Size(MB) %u\n", (uint32_t)(memory_size_mb >> 20));

    if (disk_access_ioctl(disk_pdrv, DISK_IOCTL_CTRL_DEINIT, NULL) != 0) {
        printf("Storage deinit ERROR!\n");
        return 1;
    }
    if (fs_mount(mp) != 0) {
        printf("Error mounting disk\n");
        return 1;
    }
    lsdir("/SD:");
    fs_unmount(mp);
    return 0;
}
```

## src/sd_card.h
```c
#ifndef SD_CARD_H
# define SD_CARD_H

#include <zephyr/drivers/spi.h>
#include <zephyr/storage/disk_access.h>
#include <zephyr/fs/fs.h>
#include <ff.h>
#include "measures_logger.h"

int lsdir(const char *path);
uint8_t get_disk_info();
int write_in_sd_card(FATFS *fat_fs, struct fs_mount_t *mp);

#endif
```

## src/temp_hum_sensor.c
```c
#include "temp_hum_sensor.h"

uint8_t read_temp_sensor(const struct i2c_dt_spec *temp_device, uint16_t *temp, uint16_t *humidity)
{
    uint8_t sensor_reg = 0xFD;
    uint8_t reading[6]= {0};
    uint32_t u32_temp;
	  uint32_t u32_humidity;

    // function i2c_write_read_dt doesn't generate a stop condition before switching to a read, no supported by all i2c sensor
    if(i2c_write_dt(temp_device, &sensor_reg, 1) != 0){
        printf("Failed to write/read I2C device address %x at Reg. %x \n\r", temp_device->addr, sensor_reg);
        return 1;
    }
    k_msleep(10);
    i2c_read_dt(temp_device, reading, 6);

    //Add 100�C to temp and temp multiple by 10 to keep float precision
    (*temp) = (reading[0] << 8) + reading[1];
    u32_temp = (uint32_t)(((*temp) * 267 / 10000) + 1000);
    u32_temp = u32_temp - 450;
    (*temp) = (uint16_t)u32_temp;
    //(*temp) = -45 + 175 * (*temp) / 65535;

    //Humidity multiple by 10 to keep float precision
    (*humidity) = (reading[3] << 8) + reading[4];
    u32_humidity = ((uint32_t)((*humidity) * 1907) - 6000000) / 100000;
    (*humidity) = (uint16_t)u32_humidity;
    //(*humidity) = -6 + 125 * (*humidity) / 65535;

    printf("Temperature: %d, Humidity %d\n", (*temp), (*humidity));
    return 0;
}


int routine_read_temp(const struct i2c_dt_spec *temp_device)
{
    uint16_t temp;
    uint16_t humidity;

    while (1)
    {
        k_msleep(1000);
        read_temp_sensor(temp_device, &temp, &humidity);
    }
    return 0;
}

void ftoa(float fnum, char res[5])
{
  float tmpVal  = (fnum < 0) ? -fnum : fnum;

  int   tmpInt1 = tmpVal;            // Get the integer
  float tmpFrac = tmpVal - tmpInt1;  // Get fraction
  int   tmpInt2 = (tmpFrac * 100);   // Turn into integer

  snprintf(res, 5, "%02d.%01d", tmpInt1, tmpInt2);
}

/**
 * @brief convert temperature from u16 to string readable format : +AA.A
 */
void temp_to_string(const uint16_t u16_temp, char *s_temp)
{
  float f_temperature;
  char  s_temperature[5];
  char *tmpSign;

  f_temperature = ((float)(u16_temp - 1000) / 10);
  ftoa(f_temperature, s_temperature);

  tmpSign = (f_temperature < 0) ? "-" : "+";

  snprintf(s_temp, 6, "%s%s", tmpSign, s_temperature);
}

/**
 * @brief convert humidity from u16 to string readable format : AA.A
 */
void hum_to_string(const uint16_t u16_hum, char s_hum[5])
{
  float f_humidity;

  f_humidity = ((float)u16_hum) / 10;
  ftoa(f_humidity, s_hum);
}
```

## src/temp_hum_sensor.h
```c
#ifndef TEMP_HUM_SENSOR_H
# define TEMP_HUM_SENSOR_H

#include <zephyr/drivers/i2c.h>

#define I2C_TEMP_NODE DT_NODELABEL(temp_sensor)

#if !DT_NODE_HAS_STATUS_OKAY(I2C_TEMP_NODE)
#error "Unsupported board: sensor devicetree nodelabel is not defined"
#endif

uint8_t read_temp_sensor(const struct i2c_dt_spec *temp_device, uint16_t *temp, uint16_t *humidity);
int routine_read_temp(const struct i2c_dt_spec *temp_device);
void temp_to_string(const uint16_t u16_temp, char *s_temp);
void hum_to_string(const uint16_t u16_hum, char s_hum[5]);
void ftoa(float fnum, char res[5]);

#endif
```
